// See https://zmk.dev/docs/development/hardware-integration/physical-layouts
// for how to configure this.

#include <physical_layouts.dtsi>

/ {
    keypad_position_map1 {
        compatible = "zmk,physical-layout-position-map";
        complete;

        alpha5817_map: macropad {
            physical-layout = <&alpha5817_layout>;
            positions
                = < 0  1  2  3  4  5>
                , < 6  7  8  9 10 11>
                , <12 13 14 15 16 17>;
        };
    };
};