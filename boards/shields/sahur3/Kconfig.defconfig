## boards/shields/sahur3/Kconfig.defconfig
```kconfig
if SHIELD_SAHUR3_LEFT

config ZMK_KEYBOARD_NAME
    default "tripltboard"

config ZMK_SPLIT_ROLE_CENTRAL
    default y

endif # SHIELD_SAHUR3_LEFT

if SHIELD_SAHUR3_LEFT || SHIELD_SAHUR3_RIGHT

config ZMK_SPLIT
    default y

endif # SHIELD_SAHUR3_LEFT || SHIELD_SAHUR3_RIGHT
```

## boards/shields/sahur3/Kconfig.shield
```kconfig
config SHIELD_SAHUR3_LEFT
    def_bool $(shields_list_contains,sahur3_left)

config SHIELD_SAHUR3_RIGHT
    def_bool $(shields_list_contains,sahur3_right)
```
